## config/west.yml
```yaml
manifest:
  # FIXME pick a tag/revision to pin to below in the revision fields
  remotes:
    - name: zmkfirmware
      url-base: https://github.com/zmkfirmware
    - name: jlw # You can name this whatever you like; just make sure the "remote" below matches.
      url-base: https://github.com/josh-l-wang
#    - name: urob
#      url-base: https://github.com/urob
  projects:
    - name: zmk
      remote: zmkfirmware
      revision: v0.3.0
      import: app/west.yml
#    - name: zmk-leader-key
#      remote: urob
#      revision: v0.3.0
    - name: zmk-config-jlw
      remote: jlw
      revision: main # This is the name of the branch you want to use.
  self:
    path: config
```
